// Copyright 2022 Manna Harbour
// https://github.com/manna-harbour/miryoku

#include "../miryoku/custom_config.h"
#include "../miryoku/mapping/38/totem.h"
#include "../boards/shields/totem/totem.dtsi"
#include "../miryoku/miryoku.dtsi"
